// File generated 6/13/2020 11:08:56 AM
// Warning! This is a generated file, any manual changes will be
// lost during the next generation.

#constant  Strings1Count    4
#constant  Strings1Size     14
// object indexes into ImageControl
#CONST
    iSlider0        // offset 0x0
    iStatictext0    // offset 0xC600
    iLeddigits0     // offset 0xE600
    iiLeddigits0    // offset 0x10C00
    i4Dbutton0      // offset 0x16E00
    i4Dbutton1      // offset 0x19400
    iStatictext1    // offset 0x1BA00
    iStatictext2    // offset 0x21C00
    iStatictext3    // offset 0x22200
    iStatictext8    // offset 0x22800
    iStatictext7    // offset 0x22C00
    iStatictext6    // offset 0x23000
    iStatictext5    // offset 0x23400
    iStatictext4    // offset 0x23800
    iStatictext9    // offset 0x23A00
    iStatictext10   // offset 0x23C00
    iStatictext12   // offset 0x23E00
#END

#constant  Strings0Size     0
#constant  Strings0StartH   0
#constant  Strings0StartL   0

#constant  Strings1StartH   0x0
#constant  Strings1StartL   0x0

#IFNOT EXISTS NOGLOBALS
var hndl ;
#ENDIF
